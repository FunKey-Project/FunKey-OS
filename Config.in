## FunKey/Config.in
```kconfig
source "$BR2_EXTERNAL_FUNKEY_PATH/package/fkgpiod/Config.in"
source "$BR2_EXTERNAL_FUNKEY_PATH/package/retrofe/Config.in"
source "$BR2_EXTERNAL_FUNKEY_PATH/package/dmtx-utils/Config.in"
source "$BR2_EXTERNAL_FUNKEY_PATH/package/ProdScreens/Config.in"
source "$BR2_EXTERNAL_FUNKEY_PATH/package/fonts-droid/Config.in"
source "$BR2_EXTERNAL_FUNKEY_PATH/package/libini/Config.in"
source "$BR2_EXTERNAL_FUNKEY_PATH/package/libopk/Config.in"
source "$BR2_EXTERNAL_FUNKEY_PATH/package/libxdgmime/Config.in"
source "$BR2_EXTERNAL_FUNKEY_PATH/package/gmenu2x/Config.in"
source "$BR2_EXTERNAL_FUNKEY_PATH/package/fluidlite/Config.in"
source "$BR2_EXTERNAL_FUNKEY_PATH/package/libmikmod/Config.in"
source "$BR2_EXTERNAL_FUNKEY_PATH/package/commander/Config.in"
source "$BR2_EXTERNAL_FUNKEY_PATH/package/bibi/Config.in"
source "$BR2_EXTERNAL_FUNKEY_PATH/package/picoarch/Config.in"
source "$BR2_EXTERNAL_FUNKEY_PATH/package/clock/Config.in"
source "$BR2_EXTERNAL_FUNKEY_PATH/package/st-sdl/Config.in"
```

## FunKey/configs/funkey_defconfig
```kconfig
BR2_arm=y
BR2_cortex_a7=y
BR2_ARM_FPU_VFPV4=y
BR2_DL_DIR="../download"
BR2_WGET="wget --no-check-certificate --passive-ftp -nd -t 3"
BR2_CCACHE=y
BR2_OPTIMIZE_FAST=y
BR2_SHARED_STATIC_LIBS=y
BR2_GLOBAL_PATCH_DIR="$(BR2_EXTERNAL_FUNKEY_PATH)/board/funkey/patches"
BR2_TOOLCHAIN_EXTERNAL=y
BR2_TOOLCHAIN_EXTERNAL_CUSTOM=y
BR2_TOOLCHAIN_EXTERNAL_DOWNLOAD=y
BR2_TOOLCHAIN_EXTERNAL_URL="https://github.com/FunKey-Project/FunKey-OS/releases/download/FunKey-OS-2.3.0/FunKey-sdk-2.3.0.tar.gz"
BR2_TOOLCHAIN_EXTERNAL_HEADERS_4_14=y
BR2_TOOLCHAIN_EXTERNAL_CUSTOM_MUSL=y
BR2_TOOLCHAIN_EXTERNAL_CXX=y
BR2_TOOLCHAIN_EXTERNAL_GDB_SERVER_COPY=y
BR2_TARGET_OPTIMIZATION="-fno-PIC -march=armv7-a+neon-vfpv4 -mtune=cortex-a7 -mfpu=neon-vfpv4 -mvectorize-with-neon-quad -D__ARM_NEON__"
BR2_TARGET_GENERIC_HOSTNAME="FunKey"
BR2_TARGET_GENERIC_ISSUE="Welcome to Buildroot for the FunKey"
BR2_ROOTFS_DEVICE_TABLE="$(BR2_EXTERNAL_FUNKEY_PATH)/board/funkey/device_table.txt"
BR2_TARGET_GENERIC_ROOT_PASSWD="funkey"
BR2_TARGET_GENERIC_GETTY_PORT="ttyS0"
BR2_TARGET_GENERIC_GETTY_BAUDRATE_115200=y
BR2_ROOTFS_USERS_TABLES="$(BR2_EXTERNAL_FUNKEY_PATH)/board/funkey/users_table.txt"
BR2_ROOTFS_OVERLAY="$(BR2_EXTERNAL_FUNKEY_PATH)/board/funkey/rootfs-overlay"
BR2_ROOTFS_POST_BUILD_SCRIPT="$(BR2_EXTERNAL_FUNKEY_PATH)/board/funkey/post-build.sh"
BR2_LINUX_KERNEL=y
BR2_LINUX_KERNEL_CUSTOM_TARBALL=y
BR2_LINUX_KERNEL_CUSTOM_TARBALL_LOCATION="https://github.com/DrUm78/linux/archive/refs/tags/v1.0.3-funkey-s.tar.gz"
BR2_LINUX_KERNEL_USE_CUSTOM_CONFIG=y
BR2_LINUX_KERNEL_CUSTOM_CONFIG_FILE="$(BR2_EXTERNAL_FUNKEY_PATH)/board/funkey/linux.config"
BR2_LINUX_KERNEL_LZO=y
BR2_LINUX_KERNEL_DTS_SUPPORT=y
BR2_LINUX_KERNEL_INTREE_DTS_NAME="sun8i-v3s-funkey"
BR2_LINUX_KERNEL_INSTALL_TARGET=y
BR2_PACKAGE_BUSYBOX_CONFIG="$(BR2_EXTERNAL_FUNKEY_PATH)/board/funkey/busybox.config"
BR2_PACKAGE_BUSYBOX_SHOW_OTHERS=y
BR2_PACKAGE_ALSA_UTILS=y
BR2_PACKAGE_ALSA_UTILS_ALSACONF=y
BR2_PACKAGE_ALSA_UTILS_ACONNECT=y
BR2_PACKAGE_ALSA_UTILS_ALSALOOP=y
BR2_PACKAGE_ALSA_UTILS_ALSAUCM=y
BR2_PACKAGE_ALSA_UTILS_ALSATPLG=y
BR2_PACKAGE_ALSA_UTILS_AMIDI=y
BR2_PACKAGE_ALSA_UTILS_AMIXER=y
BR2_PACKAGE_ALSA_UTILS_APLAY=y
BR2_PACKAGE_ALSA_UTILS_APLAYMIDI=y
BR2_PACKAGE_ALSA_UTILS_ARECORDMIDI=y
BR2_PACKAGE_ALSA_UTILS_ASEQDUMP=y
BR2_PACKAGE_ALSA_UTILS_ASEQNET=y
BR2_PACKAGE_ALSA_UTILS_BAT=y
BR2_PACKAGE_ALSA_UTILS_IECSET=y
BR2_PACKAGE_ALSA_UTILS_SPEAKER_TEST=y
BR2_PACKAGE_AUMIX=y
BR2_PACKAGE_MPG123=y
BR2_PACKAGE_DOSFSTOOLS=y
BR2_PACKAGE_DOSFSTOOLS_FATLABEL=y
BR2_PACKAGE_DOSFSTOOLS_FSCK_FAT=y
BR2_PACKAGE_DOSFSTOOLS_MKFS_FAT=y
BR2_PACKAGE_E2FSPROGS=y
# BR2_PACKAGE_E2FSPROGS_FSCK is not set
BR2_PACKAGE_E2FSPROGS_RESIZE2FS=y
BR2_PACKAGE_FBGRAB=y
BR2_PACKAGE_SDL=y
BR2_PACKAGE_SDL_GFX=y
BR2_PACKAGE_SDL_IMAGE=y
BR2_PACKAGE_SDL_IMAGE_GIF=y
BR2_PACKAGE_SDL_IMAGE_JPEG=y
BR2_PACKAGE_SDL_IMAGE_PNG=y
BR2_PACKAGE_SDL_MIXER=y
BR2_PACKAGE_SDL_NET=y
BR2_PACKAGE_SDL_SOUND=y
BR2_PACKAGE_SDL_SOUND_PLAYSOUND=y
BR2_PACKAGE_SDL_TTF=y
BR2_PACKAGE_GPTFDISK=y
BR2_PACKAGE_GPTFDISK_GDISK=y
BR2_PACKAGE_GPTFDISK_SGDISK=y
BR2_PACKAGE_PARTED=y
BR2_PACKAGE_SYSSTAT=y
BR2_PACKAGE_UBOOT_TOOLS=y
BR2_PACKAGE_UBOOT_TOOLS_MKENVIMAGE=y
BR2_PACKAGE_LUA=y
BR2_PACKAGE_LIBSAMPLERATE=y
BR2_PACKAGE_LIBSNDFILE=y
BR2_PACKAGE_OPENAL=y
BR2_PACKAGE_TINYALSA=y
BR2_PACKAGE_TREMOR=y
BR2_PACKAGE_LIBARCHIVE=y
BR2_PACKAGE_LIBARCHIVE_BSDTAR=y
BR2_PACKAGE_LIBARCHIVE_BSDCPIO=y
BR2_PACKAGE_LIBARCHIVE_BSDCAT=y
BR2_PACKAGE_LZO=y
BR2_PACKAGE_LIBCONFIG=y
BR2_PACKAGE_LIBQRENCODE=y
BR2_PACKAGE_LIBQRENCODE_TOOLS=y
BR2_PACKAGE_PIXMAN=y
BR2_PACKAGE_TINYXML2=y
BR2_PACKAGE_LIBNL=y
BR2_PACKAGE_LIBRSYNC=y
BR2_PACKAGE_FMT=y
BR2_PACKAGE_ICU=y
BR2_PACKAGE_DHCPCD=y
BR2_PACKAGE_DROPBEAR=y
BR2_PACKAGE_ANDROID_TOOLS=y
BR2_PACKAGE_PROCPS_NG=y
BR2_PACKAGE_SWUPDATE=y
BR2_PACKAGE_SWUPDATE_CONFIG="$(BR2_EXTERNAL_FUNKEY_PATH)/board/funkey/swupdate.config"
# BR2_PACKAGE_SWUPDATE_INSTALL_WEBSITE is not set
BR2_PACKAGE_UTIL_LINUX_BINARIES=y
BR2_PACKAGE_NANO=y
BR2_TARGET_ROOTFS_EXT2=y
BR2_TARGET_ROOTFS_EXT2_4=y
BR2_TARGET_ROOTFS_EXT2_SIZE="250M"
# BR2_TARGET_ROOTFS_TAR is not set
BR2_PACKAGE_HOST_DOSFSTOOLS=y
BR2_PACKAGE_HOST_DTC=y
BR2_PACKAGE_HOST_MTOOLS=y
BR2_PACKAGE_HOST_SQUASHFS=y
BR2_PACKAGE_HOST_UBOOT_TOOLS=y
BR2_PACKAGE_LIBOPK=y
BR2_PACKAGE_LIBXDGMIME=y
BR2_PACKAGE_GMENU2X=y
BR2_PACKAGE_GMENU2X_SHOW_CLOCK=y
BR2_PACKAGE_FLUIDLITE=y
BR2_PACKAGE_LIBMIKMOD=y
BR2_PACKAGE_COMMANDER=y
BR2_PACKAGE_P7ZIP=y
BR2_PACKAGE_UNRAR=y
BR2_PACKAGE_FILE=y
BR2_PACKAGE_HOST_PYTHON3=y
```

## FunKey/package/FCEUX/Config.in
```kconfig
config BR2_PACKAGE_FCEUX
	bool "FCEUX"
	default y
	select BR2_PACKAGE_SDL
	select BR2_PACKAGE_SDL_IMAGE
	select BR2_PACKAGE_SDL_MIXER
	select BR2_PACKAGE_SDL_TTF
	select BR2_PACKAGE_ZLIB
	help
	  An open source NES Emulator for Windows and Unix that
	  features solid emulation accuracy and state of the art tools
	  for power users. For some reason casual gamers use it too.

	  https://github.com/pingflood/fceux.git
```

## FunKey/package/FunKey-GPIO-Mapping/Config.in
```kconfig
config BR2_PACKAGE_FUNKEY_GPIO_MAPPING
	bool "FunKey GPIO Mapping"
	help
	  The FunKey GPIO mapping utility.
```

## FunKey/package/FunKey-Launcher-retrofe/Config.in
```kconfig
config BR2_PACKAGE_FUNKEY_LAUNCHER_RETROFE
	bool "FunKey retrofe launcher"
	default y
	select BR2_PACKAGE_GSTREAMER1
	select BR2_PACKAGE_GST1_PLUGINS_BASE
	select BR2_PACKAGE_LIBGLIB2
	select BR2_PACKAGE_SDL
	select BR2_PACKAGE_SDL_IMAGE
	select BR2_PACKAGE_SDL_MIXER
	select BR2_PACKAGE_SDL_TTF
	select BR2_PACKAGE_SQLITE
	select BR2_PACKAGE_ZLIB
	help
	  The FunKey retrofe launcher.
```

## FunKey/package/PCSX-ReARMed/Config.in
```kconfig
config BR2_PACKAGE_PCSX_REARMED
	bool "PCSX ReARMed"
	default y
	select BR2_PACKAGE_SDL
	select BR2_PACKAGE_SDL_IMAGE
	select BR2_PACKAGE_SDL_MIXER
	select BR2_PACKAGE_SDL_TTF
	select BR2_PACKAGE_ZLIB
	help
	  Yet another PCSX fork

	  https://github.com/notaz/pcsx_rearmed.git
```

## FunKey/package/PocketSNES/Config.in
```kconfig
config BR2_PACKAGE_POCKETSNES
	bool "PocketSNES"
	default y
	select BR2_PACKAGE_SDL
	select BR2_PACKAGE_SDL_IMAGE
	select BR2_PACKAGE_SDL_MIXER
	select BR2_PACKAGE_SDL_TTF
	select BR2_PACKAGE_ZLIB
	help
	  An open source Super NES Emulator.

	  https://github.com/buzztiaan/PocketSNES
```

## FunKey/package/ProdScreens/Config.in
```kconfig
config BR2_PACKAGE_PRODSCREENS
	bool "FunKey Prod screens"
	default y
	help
	  The screens for production tests.
```

## FunKey/package/bibi/Config.in
```kconfig
config BR2_PACKAGE_BIBI
	bool "FunKey S - bibi"
	default y
	help
	  Bomberman game in c with SDL, readapted for the FunKey S.
```

## FunKey/package/clock/Config.in
```kconfig
config BR2_PACKAGE_CLOCK
	bool "clock"
	default y
	select BR2_PACKAGE_SDL
	help
	  This is a simple app that sets the clock.

	  https://github.com/gameblabla/clock_sdl_app
```

## FunKey/package/commander/Config.in
```kconfig
config BR2_PACKAGE_COMMANDER
	bool "commander"
	select BR2_PACKAGE_LIBPNG
	select BR2_PACKAGE_SDL
	select BR2_PACKAGE_SDL_TTF
	select BR2_PACKAGE_SDL_GFX
	help

	  DinguxCommander is a file manager for RetroFW. It uses two
	  vertical panels side by side, one being the source and the
	  other the destination, like many 'commander-style' file
	  managers such as Norton Commander or Midnight
	  Commander.
```

## FunKey/package/dmtx-utils/Config.in
```kconfig
config BR2_PACKAGE_DMTX_UTILS
	bool "dmtx utils"
	depends on BR2_PACKAGE_LIBDMTX
	select BR2_PACKAGE_IMAGEMAGICK
	help
	  libdmtx is a software library that enables programs to read
	  and write Data Matrix barcodes of the modern ECC200
	  variety. This package, dmtx-utils, provides command line
	  utilities that allow scripts and command line users to use
	  libdmtx functionality.

	  https://github.com/dmtx/dmtx-utils
```

## FunKey/package/fluidlite/Config.in
```kconfig
config BR2_PACKAGE_FLUIDLITE
	bool "FluidLite"
	depends on BR2_USE_MMU
	help
	  FluidLite is a very light version of FluidSynth.
```

## FunKey/package/funkey-gpio-mapping/Config.in
```kconfig
config BR2_PACKAGE_FUNKEY_GPIO_MAPPING
	bool "funkey gpio mapping"
	help
	  The FunKey GPIO mapping utility.
```

## FunKey/package/gnuboy/Config.in
```kconfig
config BR2_PACKAGE_GNUBOY
	bool "gnuboy"
	default y
	select BR2_PACKAGE_SDL
	select BR2_PACKAGE_SDL_IMAGE
	select BR2_PACKAGE_SDL_MIXER
	select BR2_PACKAGE_SDL_TTF
	select BR2_PACKAGE_ZLIB
	help
	  Welcome to gnuboy, one of the few pieces of Free Software to emulate
	  the Game Boy handheld game console.

	  https://github.com/rofl0r/gnuboy
```

## FunKey/package/gpsp/Config.in
```kconfig
config BR2_PACKAGE_GPSP
	bool "gpsp"
	default y
	select BR2_PACKAGE_SDL
	select BR2_PACKAGE_SDL_IMAGE
	select BR2_PACKAGE_SDL_MIXER
	select BR2_PACKAGE_SDL_TTF
	select BR2_PACKAGE_ZLIB
	help
	  Gameboy Advance emulator for Playstation Portable

	  https://github.com/FoxCunning/gpsp.git
```

## FunKey/package/libmikmod/Config.in
```kconfig
config BR2_PACKAGE_LIBMIKMOD
	bool "libmikmod"
	help
	  Mikmod is a module player and library supporting many
	  tracker formats, including mod, s3m, it, and xm.

	  http://mikmod.shlomifish.org/
```

## FunKey/package/mednafen/Config.in
```kconfig
config BR2_PACKAGE_MEDNAFEN
	bool "mednafen"
	default y
	select BR2_PACKAGE_SDL
	select BR2_PACKAGE_SDL_IMAGE
	select BR2_PACKAGE_SDL_MIXER
	select BR2_PACKAGE_SDL_TTF
	select BR2_PACKAGE_ZLIB
	help
	  The mednafen game engine.

	  https://mednafen.github.io/
```

## FunKey/package/picoarch/Config.in
```kconfig
config BR2_PACKAGE_PICOARCH
	bool "picoarch"
	default y
	select BR2_PACKAGE_SDL
	select BR2_PACKAGE_SDL_IMAGE
	select BR2_PACKAGE_SDL_TTF
	help
	  A Libretro frontend designed for small screens and low power

	  https://git.crowdedwood.com/picoarch
```

## FunKey/package/picodrive/Config.in
```kconfig
config BR2_PACKAGE_PICODRIVE
	bool "picodrive"
	default y
	select BR2_PACKAGE_SDL
	select BR2_PACKAGE_SDL_IMAGE
	select BR2_PACKAGE_SDL_MIXER
	select BR2_PACKAGE_SDL_TTF
	select BR2_PACKAGE_ZLIB
	help
	This is yet another Megadrive / Genesis / Sega CD / Mega CD /
	32X / SMS emulator, which was written having ARM-based
	handheld devices in mind (such as smartphones and handheld
	consoles like GP2X and Pandora), but also runs on non-ARM
	little-endian hardware too.


	  https://github.com/notaz/picodrive
```

## FunKey/package/retrofe-layout/Config.in
```kconfig
config BR2_PACKAGE_RETROFE_LAYOUT
	bool "retrofe layout"
	help
	  The cross-platform game frontend layout.

	  https://bitbucket.org/phulshof/retrofe/src/default/
```

## FunKey/package/retrofe/Config.in
```kconfig
config BR2_PACKAGE_RETROFE
	bool "RetroFE retro game front-end"
	default y
	select BR2_PACKAGE_GSTREAMER1
	select BR2_PACKAGE_GST1_PLUGINS_BASE
	select BR2_PACKAGE_LIBGLIB2
	select BR2_PACKAGE_SDL
	select BR2_PACKAGE_SDL_IMAGE
	select BR2_PACKAGE_SDL_MIXER
	select BR2_PACKAGE_SDL_TTF
	select BR2_PACKAGE_SQLITE
	select BR2_PACKAGE_ZLIB
	help
	  RetroFE is a front-end, which can be used as a graphical
	  user interface to display, select and launch your games,
	  videos, and programs. Its most common usage is for game
	  emulation. RetroFE allows you to define collections, which
	  can be displayed using a menu structure with additional
	  artwork like video, box art, screenshots, etc.

	  https://bitbucket.org/phulshof/retrofe
```

## FunKey/package/st-sdl/Config.in
```kconfig
config BR2_PACKAGE_ST_SDL
	bool "st-sdl"
	default y
	select BR2_PACKAGE_SDL
	help
	  SDL Terminal for RS97

	  https://github.com/jamesofarrell/st-sdl
```

## PCBA/configs/funkey_defconfig
```kconfig
BR2_arm=y
BR2_cortex_a7=y
BR2_DL_DIR="$(BR2_EXTERNAL_FUNKEY_PATH)/dl"
BR2_CCACHE=y
BR2_GLOBAL_PATCH_DIR="$(BR2_EXTERNAL_FUNKEY_PATH)/board/funkey/patches"
BR2_TOOLCHAIN_EXTERNAL=y
BR2_TOOLCHAIN_EXTERNAL_GDB_SERVER_COPY=y
BR2_TARGET_GENERIC_HOSTNAME="FunKey"
BR2_TARGET_GENERIC_ISSUE="Welcome to Buildroot for the FunKey"
BR2_ROOTFS_DEVICE_TABLE="$(BR2_EXTERNAL_FUNKEY_PATH)/board/funkey/device_table.txt"
BR2_TARGET_GENERIC_ROOT_PASSWD="funkey"
BR2_TARGET_GENERIC_GETTY_PORT="ttyS0"
BR2_TARGET_GENERIC_GETTY_BAUDRATE_115200=y
BR2_ROOTFS_USERS_TABLES="$(BR2_EXTERNAL_FUNKEY_PATH)/board/funkey/users_table.txt"
BR2_ROOTFS_OVERLAY="$(BR2_EXTERNAL_FUNKEY_PATH)/board/funkey/rootfs-overlay"
BR2_ROOTFS_POST_BUILD_SCRIPT="$(BR2_EXTERNAL_FUNKEY_PATH)/board/funkey/post-build.sh"
BR2_LINUX_KERNEL=y
BR2_LINUX_KERNEL_CUSTOM_GIT=y
BR2_LINUX_KERNEL_CUSTOM_REPO_URL="https://github.com/Lichee-Pi/linux"
BR2_LINUX_KERNEL_CUSTOM_REPO_VERSION="cda44c146b9b87290bc7c636ffa7d88cbfb03ace"
BR2_LINUX_KERNEL_USE_CUSTOM_CONFIG=y
BR2_LINUX_KERNEL_CUSTOM_CONFIG_FILE="$(BR2_EXTERNAL_FUNKEY_PATH)/board/funkey/linux.config"
BR2_LINUX_KERNEL_LZMA=y
BR2_LINUX_KERNEL_DTS_SUPPORT=y
BR2_LINUX_KERNEL_INTREE_DTS_NAME="sun8i-v3s-funkey"
BR2_PACKAGE_BUSYBOX_CONFIG="$(BR2_EXTERNAL_FUNKEY_PATH)/board/funkey/busybox.config"
BR2_PACKAGE_BUSYBOX_SHOW_OTHERS=y
BR2_PACKAGE_ALSA_UTILS=y
BR2_PACKAGE_ALSA_UTILS_ALSACONF=y
BR2_PACKAGE_ALSA_UTILS_ACONNECT=y
BR2_PACKAGE_ALSA_UTILS_ALSALOOP=y
BR2_PACKAGE_ALSA_UTILS_ALSAUCM=y
BR2_PACKAGE_ALSA_UTILS_ALSATPLG=y
BR2_PACKAGE_ALSA_UTILS_AMIDI=y
BR2_PACKAGE_ALSA_UTILS_AMIXER=y
BR2_PACKAGE_ALSA_UTILS_APLAY=y
BR2_PACKAGE_ALSA_UTILS_APLAYMIDI=y
BR2_PACKAGE_ALSA_UTILS_ARECORDMIDI=y
BR2_PACKAGE_ALSA_UTILS_ASEQDUMP=y
BR2_PACKAGE_ALSA_UTILS_ASEQNET=y
BR2_PACKAGE_ALSA_UTILS_BAT=y
BR2_PACKAGE_ALSA_UTILS_IECSET=y
BR2_PACKAGE_ALSA_UTILS_SPEAKER_TEST=y
BR2_PACKAGE_AUMIX=y
# BR2_PACKAGE_IFUPDOWN_SCRIPTS is not set
BR2_PACKAGE_NANO=y
BR2_TARGET_ROOTFS_CPIO_LZMA=y
BR2_TARGET_ROOTFS_CPIO_UIMAGE=y
BR2_TARGET_ROOTFS_INITRAMFS=y
# BR2_TARGET_ROOTFS_TAR is not set
BR2_TARGET_UBOOT=y
BR2_TARGET_UBOOT_BUILD_SYSTEM_KCONFIG=y
BR2_TARGET_UBOOT_CUSTOM_GIT=y
BR2_TARGET_UBOOT_CUSTOM_REPO_URL="https://github.com/Lichee-Pi/u-boot"
BR2_TARGET_UBOOT_CUSTOM_REPO_VERSION="32ab1804cd7c5858be8009e35ca07502dc8765c7"
BR2_TARGET_UBOOT_USE_CUSTOM_CONFIG=y
BR2_TARGET_UBOOT_CUSTOM_CONFIG_FILE="$(BR2_EXTERNAL_FUNKEY_PATH)/board/funkey/uboot.config"
BR2_TARGET_UBOOT_NEEDS_DTC=y
BR2_TARGET_UBOOT_FORMAT_CUSTOM=y
BR2_TARGET_UBOOT_FORMAT_CUSTOM_NAME="u-boot-sunxi-with-spl.bin"
BR2_TARGET_UBOOT_BOOT_SCRIPT=y
BR2_TARGET_UBOOT_BOOT_SCRIPT_SOURCE="$(BR2_EXTERNAL_FUNKEY_PATH)/board/funkey/boot.cmd"
```
